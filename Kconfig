## Kconfig
```kconfig
# SPDX-FileCopyrightText: 2026 roolrz
# SPDX-License-Identifier: Apache-2.0

config SYSTEM_APP_EDITOR
    bool "editor (/bin/editor)"
    default y
    depends on SYSTEM_APP_TERMINAL_SERVICE
    help
        Build and deploy hyper-editor at /bin/editor.
```
